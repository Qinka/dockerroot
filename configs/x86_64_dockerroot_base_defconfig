## configs/x86_64_dockerroot_base_defconfig
```kconfig
BR2_x86_64=y
BR2_BACKUP_SITE="http://sources.buildroot.net"
BR2_KERNEL_MIRROR="https://mirror.nyist.edu.cn/kernel/"
BR2_GNU_MIRROR="https://mirror.nyist.edu.cn/gnu/"
BR2_LUAROCKS_MIRROR="https://luarocks.cn"
BR2_CPAN_MIRROR="https://mirror.nyist.edu.cn/CPAN/"
BR2_OPTIMIZE_3=y
BR2_ROOTFS_SKELETON_CUSTOM=y
BR2_ROOTFS_SKELETON_CUSTOM_PATH="system/dockerroot/default"
BR2_INIT_NONE=y
BR2_ROOTFS_DEVICE_CREATION_STATIC=y
BR2_ROOTFS_DEVICE_TABLE=""
BR2_ROOTFS_STATIC_DEVICE_TABLE=""
# BR2_PACKAGE_BUSYBOX is not set
BR2_PACKAGE_CA_CERTIFICATES=y
```
